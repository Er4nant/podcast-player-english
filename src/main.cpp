// =====================================================================
// Cardputer ADV podcast RSS online player (v3 polished UI)
//
// Hardware: M5Stack Cardputer ADV (ESP32-S3, 8MB Flash, no PSRAM)
// Display: ST7789, native 135x240 + rotation 1 -> canvas 240x135 (M5GFX 0.2.33)
// Audio: onboard ES8311 codec, I2C bus SDA=8 / SCL=9 (auto-initialized by M5Unified),
//        I2S_NUM_1, BCLK=41 / WS=43 / DOUT=42, no MCLK line
//        (ES8311 register 0x01=0xB5 sets MCLK=BCLK).
//        Speaker and 3.5mm headphone share the HP driver output path (register 0x13=0x10).
//
// Audio backend: ESP32-audioI2S 3.0.12 (HTTPS insecure / redirects / built-in M4A-AAC).
// Wi-Fi setup: tzapu/WiFiManager v2.0.17 -- device starts hotspot PodcastPlayer; phone joins
// and the config page pops up (192.168.4.1) to pick a network and enter the password;
// credentials are stored in NVS, no hardcoded WiFi. Feed source (Xiaoyuzhou) is all .m4a; ESP8266Audio cannot handle the MP4 container (v1 lesson).
//
// UI (v3.4 black-and-white palette: pure black background + white text with gray levels; only cover art is color):
//   - List page: status bar + 6-row episode list, Enter plays and opens the player page
//   - Player page: 100x100 embedded cover on the left (cover.h, generated by gen_cover.py),
//     right side channel name / two-line title / white progress bar / current and total time; progress redraws locally each second
//   - Keys: ';'/w and '.'/s move the cursor (list page) or return to the list (player page)
//     Enter play/pause/resume, '+'/'=' and '-'/'_' volume, '`' exits to M5Launcher
//   - On end of file (EOF) it auto-sets "Finished" and refreshes the screen
//
// Known limits (MVP trade-offs): pause uses pauseResume(); position is exact while the connection is alive;
// if paused too long the CDN may disconnect, then press Enter to restart from the beginning.
//
// Key implementation notes:
//   - ES8311 is initialized after connecttohost succeeds (I2S clock already running),
//     mirroring the timing of M5Unified's speaker post-start callback.
//   - An app launched by M5Launcher stays in this app after reboot (otadata),
//     so a key to return to the Launcher must be provided.
// =====================================================================

#include <M5Unified.h>
#ifdef PODCAST_TARGET_STICKS3
// StickS3: no keyboard, two-button input; M5Unified auto-detects the board at runtime
#else
#include <M5Cardputer.h>
#endif

#include <WiFi.h>
#include <HTTPClient.h>
#include <WiFiClientSecure.h>
#include <Preferences.h>  // channel selection persistence

#include <WiFiManager.h>  // tzapu/WiFiManager: hotspot + captive portal setup

#include "Audio.h"  // ESP32-audioI2S 3.0.12

#include "catalog.h"   // show charts/search JSON parsing (ArduinoJson)
#include "channels.h"  // compile-time embedded fallback channel table (generated by tools/gen_channels.py)

#include <SD.h>      // SD card: channels.txt (change channels without reflashing)
#include <SPI.h>

#include <tinyxml2.h>

#include <esp_ota_ops.h>

#include <algorithm>
#include <vector>
#include <string>

// ========================== Editable config section ==========================
// WiFi: WiFiManager captive portal setup (no hardcoded credentials, open-source friendly) --
// first boot the device starts hotspot PodcastPlayer; phone joins and the config page pops up to pick a network and enter the password;
// credentials are stored in NVS, then it auto-connects on boot. Press 0 on the list page to reconfigure.
//
// Channels: maintained in channels.txt at the repo root (each line: channel name|RSS URL|cover|crop width);
// tools/gen_channels.py auto-generates src/channels.h at build time, no C++ edits needed.
// Press Tab on the list page to open the channel switcher (the Esc key isn't reported by the keyboard library, so Tab is used instead).
static const char* AP_NAME = "PodcastPlayer";  // config hotspot name

#ifdef PODCAST_TARGET_STICKS3
// StickS3 version's single hardcoded channel (change these two lines and rebuild to switch)
static const char* const STICKS3_CHANNEL_NAME = "Ni Da Podcast";  // user-replaceable display name
static const char* const STICKS3_CHANNEL_RSS =
    "https://feed.xyzfm.space/xlgejk3wbj8q";

// StickS3 onboard ES8311 codec: I2S_NUM_0, pinout copied from M5Unified 0.2.26
// board_M5StickS3 speaker config (MCLK=BCLK, codec needs no separate MCLK)
static constexpr int PIN_I2S_BCLK = 17;
static constexpr int PIN_I2S_WS   = 15;
static constexpr int PIN_I2S_DOUT = 14;
static constexpr int PIN_I2S_MCLK = 18;
// The power amplifier (PA) is controlled by power chip M5PM1@0x6E gpio3 (register 0x11 bit3)
static constexpr uint8_t M5PM1_ADDR = 0x6E;
#else
// Cardputer ADV onboard audio pins (matches M5Unified 0.2.26's
// speaker config for CardputerADV: I2S_NUM_1, no MCLK)
static constexpr int PIN_I2S_BCLK = 41;
static constexpr int PIN_I2S_WS   = 43;
static constexpr int PIN_I2S_DOUT = 42;
#endif

// Operation hint text differs per target (keyboard-less devices use A/B key wording)
#ifdef PODCAST_TARGET_STICKS3
static const char* const HINT_RETRY = "B: retry fetch";
static const char* const HINT_BACK  = "A: back to list";
#else
static const char* const HINT_RETRY = "Enter: retry fetch";
static const char* const HINT_BACK  = "w/s: back to list";
#endif

static constexpr uint8_t ES8311_ADDR = 0x18;  // alternate address 0x19

// Memory trade-offs (no PSRAM, 320KB SRAM):
//   MAX_EPISODES   30 episodes ~ 10KB resident (feed measured 163 items, can't scroll that deep)
//   MAX_ITEM_BYTES measured existing items exceed 16KB (shows with long shownotes), 32KB cap;
//                  oversized items resync to the next one (see fetchEpisodesFrom)
//   audio input ring  setBufsize 12KB (see startPlayback), ~1~1.5s at 96kbps
static constexpr size_t   MAX_EPISODES   = 30;        // max episodes to parse
static constexpr size_t   MAX_ITEM_BYTES = 32 * 1024; // max bytes per item
static constexpr size_t   MAX_FEED_BYTES = 2u * 1024 * 1024;  // feed read cap
static constexpr int      VOLUME_MAX     = 16;
static constexpr uint8_t  VOLUME_DEFAULT = 12;
// =================================================================

// ------------------------ Colors (black/white/gray; only cover art is color) ------------------------
static constexpr uint16_t C_BG      = 0x0000;  // pure black background
static constexpr uint16_t C_ACCENT  = 0xFFFF;  // accent = white (title/progress bar/cursor/cover frame)
static constexpr uint16_t C_BAR_BG  = 0x2104;  // progress bar track = dark gray
static constexpr uint16_t C_SELECT  = 0x2104;  // list selected-row background = dark gray
static constexpr uint16_t C_TEXT    = 0xFFFF;  // body text white
static constexpr uint16_t C_DIM     = 0x7BEF;  // secondary gray
static constexpr uint16_t C_WARN    = 0xFFFF;  // alert = white (black-and-white theme)

// --------------------------- Global state ---------------------------
struct Episode {
  std::string title;  // episode title (whitespace already cleaned)
  std::string url;    // direct audio URL (<enclosure url="...">, this feed is .m4a)
};
static std::vector<Episode> episodes;
// Show discovery (charts / search). A show loaded from there overrides the channel RSS
// until the user switches channel. Empty activeFeedUrl = use the channel's RSS.
static std::string activeFeedUrl;
static std::string activeFeedName;

enum View { VIEW_LIST, VIEW_PLAYER, VIEW_CHANNEL, VIEW_SHOWS, VIEW_SEARCH };
static View view      = VIEW_LIST;  // current page
static int  chanIdx    = 0;         // current channel index (persisted in NVS)
static int  chanCursor = 0;         // channel page cursor
static int  chanTop    = 0;         // channel page scroll window top
static bool refetchNeeded = false;  // RSS changed on the config page, episode list needs refetch

// ------------------------- Runtime channel table -------------------------
// Priority: SD card /channels.txt (change channels without reflashing) > NVS cache > compiled-in.
// No image assets for covers: a text badge is auto-generated from the channel name (see drawCoverArt)
struct ChannelEntry {
  std::string name;
  std::string rss;
};
static std::vector<ChannelEntry> channels;
static bool sdReady = false;

static SPIClass sdSPI(HSPI);
// SD pins (Cardputer layout; the LCD uses its own bus 34~37, no conflict)
constexpr int PIN_SD_SCK = 40, PIN_SD_MISO = 39, PIN_SD_MOSI = 14,
              PIN_SD_CS = 12;

// ---------------- Channel text cover (auto-generated, no image assets) ----------------
// Each channel picks a color scheme by name hash: gradient background + white corners + large channel name
static inline uint16_t RGB888(uint8_t r, uint8_t g, uint8_t b) {
  return ((r >> 3) << 11) | ((g >> 2) << 5) | (b >> 3);
}

struct CoverScheme {
  uint8_t  r1, g1, b1;  // gradient top
  uint8_t  r2, g2, b2;  // gradient bottom
  uint16_t text;        // text/corner color
};

static const CoverScheme kCoverSchemes[] = {
    { 96,  52, 176,   38,  14,  82, 0xFFFF},  // purple (Ni Da original color family)
    {  0, 128, 138,    0,  48,  72, 0xFFFF},  // cyan
    {178,  44,  64,   88,   8,  30, 0xFFFF},  // crimson
    {206, 116,  24,  122,  48,   8, 0xFFFF},  // orange
    { 28, 126,  96,    8,  58,  46, 0xFFFF},  // pine green
    { 52,  72, 190,   14,  22,  92, 0xFFFF},  // indigo
};
static const int kSchemeCount =
    sizeof(kCoverSchemes) / sizeof(kCoverSchemes[0]);

// FNV-1a hash: same-named channels always get the same colors
static uint32_t nameHash(const std::string& s) {
  uint32_t h = 2166136261u;
  for (unsigned char c : s) {
    h ^= c;
    h *= 16777619u;
  }
  return h ^ (h >> 16);
}

// Small color block on the channel list page (uses the gradient top color)
static uint16_t coverTopColor(const std::string& name) {
  const CoverScheme& sc = kCoverSchemes[nameHash(name) % kSchemeCount];
  return RGB888(sc.r1, sc.g1, sc.b1);
}

// Text cover: vertical gradient background + inner corners + centered large channel name + bottom accent line
static void drawCoverArt(int x, int y, int w, int h,
                         const std::string& name) {
  auto& d = M5.Display;
  const CoverScheme& sc = kCoverSchemes[nameHash(name) % kSchemeCount];

  // gradient background (per-row interpolation)
  for (int i = 0; i < h; ++i) {
    int t = (h > 1) ? i * 255 / (h - 1) : 0;
    uint8_t r = sc.r1 + (sc.r2 - sc.r1) * t / 255;
    uint8_t g = sc.g1 + (sc.g2 - sc.g1) * t / 255;
    uint8_t b = sc.b1 + (sc.b2 - sc.b1) * t / 255;
    d.drawFastHLine(x, y + i, w, RGB888(r, g, b));
  }

  // Four white L-shaped corners (badge feel)
  const int arm = 7, off = 5;
  uint16_t ln = sc.text;
  d.drawFastHLine(x + off, y + off, arm, ln);
  d.drawFastVLine(x + off, y + off, arm, ln);
  d.drawFastHLine(x + w - off - arm, y + off, arm, ln);
  d.drawFastVLine(x + w - off - 1, y + off, arm, ln);
  d.drawFastHLine(x + off, y + h - off - 1, arm, ln);
  d.drawFastVLine(x + off, y + h - off - arm, arm, ln);
  d.drawFastHLine(x + w - off - arm, y + h - off - 1, arm, ln);
  d.drawFastVLine(x + w - off - 1, y + h - off - arm, arm, ln);

  // Color is already picked by name hash; now lay out the text: first try 2x size (32px/char),
  // if it doesn't fit (more than 3 lines or over the line limit) fall back to 1x (16px/char)
  auto countChars = [](const std::string& s) {
    int n = 0;
    for (unsigned char c : s)
      if ((c & 0xC0) != 0x80) ++n;  // UTF-8 continuation bytes don't count
    return n;
  };
  int nch = countChars(name);
  int size = 1, cpl = (w - 20) / 16, maxLines = (h - 16) / 16;
  int lines = (nch + cpl - 1) / cpl;
  if (lines <= 3) {  // may fit large text
    int cpl2 = (w - 20) / 32;
    int mL2  = (h - 16) / 32;
    int ln2  = (nch + cpl2 - 1) / cpl2;
    if (ln2 >= 1 && ln2 <= mL2 && ln2 <= 3) {
      size = 2;
      cpl = cpl2;
      lines = ln2;
      maxLines = mL2;
    }
  }
  if (lines > maxLines) lines = maxLines;  // truncate overlong names
  if (lines < 1) lines = 1;

  // Centered layout drawing (breaks lines at UTF-8 codepoint boundaries)
  d.setTextDatum(m5gfx::textdatum_t::top_center);
  d.setTextColor(sc.text);  // transparent background, gradient shows through
  d.setTextSize(size);
  int lh     = 16 * size;
  int yStart = y + (h - lines * lh) / 2;
  std::string rem = name;
  for (int i = 0; i < lines && !rem.empty(); ++i) {
    int cnt = 0, cut = (int)rem.size();
    for (size_t p = 0; p < rem.size(); ++p) {
      if ((rem[p] & 0xC0) != 0x80 && ++cnt > cpl) {
        cut = (int)p;
        break;
      }
    }
    std::string seg = rem.substr(0, cut);
    d.drawString(seg.c_str(), x + w / 2, yStart + i * lh);
    rem.erase(0, cut);
  }

  // Small accent line below the text block (centered)
  int yEnd = yStart + lines * lh;
  if (yEnd + 8 <= y + h - off) {
    d.fillRect(x + w / 2 - 12, yEnd + 4, 24, 2, sc.text);
  }

  // Restore default text state (the rest of the page relies on top_left + size 1)
  d.setTextDatum(m5gfx::textdatum_t::top_left);
  d.setTextSize(1);
}
static int  cursor    = 0;          // current selected row (list page)
static int  scrollTop = 0;          // episode index at the top of the list window
static bool wifiOk    = false;
static bool uiDirty   = true;       // needs full-page redraw
static std::string statusMsg;       // hint text in the middle of the status bar (e.g. "Buffering...")

#ifdef PODCAST_TARGET_STICKS3
static Audio audio(false, 3, I2S_NUM_0);  // StickS3 codec (ES8311) on I2S port 0
#else
static Audio audio(false, 3, I2S_NUM_1);  // external DAC, stereo, I2S port 1
#endif
static bool    i2sConfigured = false;     // setPinout/volume done only once
static bool    es8311Ready   = false;     // ES8311 init success flag
// StickS3 brownout avoidance: delay the amp enable + volume fade-in, to stagger away from
// connecttohost's WiFi/TLS current spike (otherwise the first playback browns out and reboots)
static uint32_t ampEnableAt = 0;  // scheduled amp enable time, 0 = nothing pending
static int      ampFadeNow  = 0;  // current fade-in volume, 0 = fade-in done / not started
static uint32_t ampFadeAt   = 0;  // next fade-in step time
static bool    paused        = false;     // user pause state
static bool    wifiDropPause = false;     // stopped mid-playback due to WiFi drop; prompt to replay after recovery

static struct {
  int     current = -1;                  // index of the currently loaded episode
  uint8_t volume  = VOLUME_DEFAULT;
} player;

static int listLines  = 6;    // list visible row count, computed in setup from the actual screen height
static int listTop    = 20;   // list area start y
static int lineHeight = 19;   // row height

static void drawUI();
static void drawPlayerPage(bool full);
static void drawChannelPage();   // channel switcher page
static void drawPortalScreen();  // config hotspot info page
static bool openPortal();        // reopen the config hotspot (list page presses 0)

// --------------------- WiFi setup (captive portal) ---------------------

#ifdef PODCAST_TARGET_STICKS3
// Channel params submitted on the config page -> update the runtime channel and write NVS (change without reflashing).
// Returns whether the RSS changed (episode list needs a refetch).
//   - changed to a new http(s) address: save to NVS
//   - RSS field cleared: clear NVS, restore the firmware built-in channel
//   - otherwise (unchanged / not http-prefixed): ignore
static bool applyPortalChannel(const char* name, const char* rss) {
  String newName(name), newRss(rss);
  newName.trim();
  newRss.trim();
  String cur(channels[0].rss.c_str());
  Preferences p;
  bool changed = false;
  if (newRss.length() == 0) {
    if (cur != STICKS3_CHANNEL_RSS) {  // cleared = restore built-in channel
      p.begin("stickchan", false);
      p.clear();
      p.end();
      channels[0].name = STICKS3_CHANNEL_NAME;
      channels[0].rss  = STICKS3_CHANNEL_RSS;
      changed = true;
      Serial.println("[chan] restored built-in channel");
    }
  } else if (newRss != cur && newRss.startsWith("http")) {
    p.begin("stickchan", false);
    p.putString("rss", newRss);
    p.putString("name", newName.length() ? newName
                                         : String(STICKS3_CHANNEL_NAME));
    p.end();
    channels[0].name = newName.length() ? newName.c_str()
                                        : STICKS3_CHANNEL_NAME;
    channels[0].rss  = newRss.c_str();
    changed = true;
    Serial.printf("[chan] custom channel saved: %s\n", newRss.c_str());
  }
  return changed;
}
#endif

// Config info page: after the phone joins the device hotspot, DNS hijacking auto-pops the config page;
// setAPCallback is called by WiFiManager when the hotspot is ready
// Config-hotspot password: random per boot (esp_random), 8 chars (WiFiManager minimum).
// Not stored in the repo, so the open hotspot can't be used to change Wi-Fi/RSS by anyone nearby.
static char portalPass[9] = {0};
static void makePortalPassword() {
  static const char kAlpha[] = "ABCDEFGHJKLMNPQRSTUVWXYZ23456789";  // no 0/O/1/I
  for (int i = 0; i < 8; ++i) portalPass[i] = kAlpha[esp_random() % (sizeof(kAlpha) - 1)];
  portalPass[8] = '\0';
}

static void drawPortalScreen() {
  auto& d = M5.Display;
  d.fillScreen(C_BG);
  d.setTextDatum(m5gfx::textdatum_t::top_left);
  d.setFont(&fonts::efontCN_16);
  d.setTextColor(C_ACCENT, C_BG);
  d.drawString("Wi-Fi setup", 2, 4);
  d.setTextColor(C_TEXT, C_BG);
  d.drawString("1. Join hotspot", 2, 26);
  d.drawString("   PodcastPlayer", 2, 44);
  d.drawString("2. Open 192.168.4.1", 2, 62);
#ifdef PODCAST_TARGET_STICKS3
  d.drawString("3. Pick WiFi + password", 2, 80);
  d.drawString("4. Same page: RSS", 2, 98);
#else
  d.drawString("3. Pick WiFi + password", 2, 98);
#endif
  d.drawString(String("Hotspot pass: ") + portalPass, 2, 116);
}

// Open the config hotspot (blocking): WiFiManager runs a webserver + DNS internally until connected
// or timeout. On first boot with no credentials, setup goes through autoConnect (tries stored credentials first);
// afterwards press 0 to reconfigure here. Returns whether WiFi connected.
static bool openPortal() {
  WiFiManager wm;
  makePortalPassword();
  wm.setConnectTimeout(10);        // wait for a connect attempt with stored credentials
  wm.setConfigPortalTimeout(180);  // auto-close the hotspot after 3 min of inactivity
  wm.setAPCallback([](WiFiManager*) { drawPortalScreen(); });
#ifdef PODCAST_TARGET_STICKS3
  // Config page includes channel settings: prefills the currently active channel; saving switches channels (stored
  // in NVS, no reflash). Saving with the RSS field cleared = restore the firmware built-in channel
  WiFiManagerParameter prmName("chan", "Channel name", channels[0].name.c_str(), 48);
  WiFiManagerParameter prmRss("rss", "Podcast RSS URL",
                              channels[0].rss.c_str(), 256);
  wm.addParameter(&prmName);
  wm.addParameter(&prmRss);
#endif
  bool ok = wm.startConfigPortal(AP_NAME, portalPass);
  wifiOk = ok && (WiFi.status() == WL_CONNECTED);
  if (wifiOk) {
    WiFi.setSleep(false);           // online streaming needs stable throughput
    WiFi.setAutoReconnect(true);    // auto-reconnect at the low level after a router blip
  }
#ifdef PODCAST_TARGET_STICKS3
  if (applyPortalChannel(prmName.getValue(), prmRss.getValue())) {
    refetchNeeded = true;  // top of loop triggers refetch of the new channel
  }
#endif
  uiDirty = true;                    // restore main UI (redrawn in loop)
  return wifiOk;
}

// --------------------------- Utility functions ---------------------------

// Clean XML text: strip newlines/tabs, collapse runs of spaces, trim leading/trailing whitespace
static std::string cleanText(const char* raw) {
  std::string out;
  if (raw == nullptr) return out;
  out.reserve(strlen(raw));
  bool prevSpace = true;  // also swallow leading spaces
  for (const char* p = raw; *p; ++p) {
    unsigned char c = (unsigned char)*p;
    if (c == '\r' || c == '\n' || c == '\t') c = ' ';
    if (c == ' ') {
      if (prevSpace) continue;
      prevSpace = true;
    } else {
      prevSpace = false;
    }
    out.push_back((char)c);
  }
  while (!out.empty() && out.back() == ' ') out.pop_back();
  return out;
}

// Byte-sequence length and display width of a single UTF-8 char (efontCN_16: full-width 16px, half-width 8px)
static void utf8CharAt(const std::string& s, size_t i, int& seq, int& cw) {
  unsigned char c = (unsigned char)s[i];
  if      (c >= 0xF0) { seq = 4; cw = 16; }
  else if (c >= 0xE0) { seq = 3; cw = 16; }
  else if (c >= 0xC0) { seq = 2; cw = 8;  }
  else                { seq = 1; cw = 8;  }
}

// Truncate by display width (appends "..."; never cuts inside a multibyte char)
static std::string fitText(const std::string& s, int max_px) {
  const int ellipsis_px = 3 * 8;
  int w = 0;
  size_t i = 0;
  while (i < s.size()) {
    int seq, cw;
    utf8CharAt(s, i, seq, cw);
    if (w + cw > max_px - ellipsis_px) {
      size_t cut = i;
      while (cut > 0 && ((unsigned char)s[cut] & 0xC0) == 0x80) --cut;
      return s.substr(0, cut) + "...";
    }
    w += cw;
    i += seq;
  }
  return s;
}

// Wrap by display width (at most max_lines lines; the last line gets "..." if it overflows)
static std::vector<std::string> wrapText(const std::string& s, int max_px,
                                         int max_lines) {
  std::vector<std::string> lines;
  size_t i = 0;
  while (i < s.size() && (int)lines.size() < max_lines) {
    std::string line;
    int w = 0;
    bool overflow = false;
    while (i < s.size()) {
      int seq, cw;
      utf8CharAt(s, i, seq, cw);
      if (w + cw > max_px) {
        // current line has more content -> mark as wrapped
        if ((int)lines.size() == max_lines - 1) overflow = true;
        break;
      }
      line += s.substr(i, seq);
      w += cw;
      i += seq;
    }
    if (overflow) {
      // last line can't hold the rest: back off one char and append an ellipsis
      while (!line.empty() && ((unsigned char)line.back() & 0xC0) == 0x80) {
        line.pop_back();
      }
      if (!line.empty()) line.pop_back();
      // re-crop by ellipsis width after backing off the char
      int lw = 0;
      for (size_t k = 0; k < line.size();) {
        int seq, cw;
        utf8CharAt(line, k, seq, cw);
        lw += cw;
        k += seq;
      }
      while (lw > max_px - 24 && !line.empty()) {
        char lc = line.back();
        line.pop_back();
        lw -= ((lc & 0x80) == 0) ? 8 : 0;
        // trailing bytes of a multibyte char are peeled one by one; fix width until the char head is reached
        if (!line.empty() && ((unsigned char)line.back() & 0xC0) == 0x80) {
          continue;
        }
        break;
      }
      line += "...";
    }
    lines.push_back(line);
  }
  return lines;
}

// seconds -> "mm:ss" or "h:mm:ss"
static std::string fmtTime(uint32_t sec) {
  if (sec == 0) return "--:--";
  char buf[16];
  uint32_t h = sec / 3600, m = (sec % 3600) / 60, s = sec % 60;
  if (h > 0) {
    snprintf(buf, sizeof(buf), "%u:%02u:%02u",
             (unsigned)h, (unsigned)m, (unsigned)s);
  } else {
    snprintf(buf, sizeof(buf), "%02u:%02u", (unsigned)m, (unsigned)s);
  }
  return buf;
}

// --------------------------- ES8311 ---------------------------

// Write ES8311 registers via M5Unified's internal I2C bus (CardputerADV: SDA=8 / SCL=9,
// M5.begin already auto-initializes it)
static bool es8311Write(uint8_t addr, uint8_t reg, uint8_t val) {
  return M5.In_I2C.writeRegister8(addr, reg, val, 100000);
}

// ES8311 init. The register sequence is copied verbatim from M5Unified 0.2.26's
// CardputerADV speaker callback (src/M5Unified.inl).
// Must be called after the I2S clock is running (M5Unified does this write in the
// speaker post-start callback), so it runs after connecttohost succeeds.
static bool initEs8311() {
  uint8_t addr = ES8311_ADDR;
  if (!es8311Write(addr, 0x00, 0x80)) {       // write RESET first to probe the address
    addr = 0x19;
    if (!es8311Write(addr, 0x00, 0x80)) {
      Serial.println("[audio] ES8311 not found (0x18/0x19)");
      return false;
    }
  }
  static const uint8_t seq[][2] = {
      {0x00, 0x80},  // 0x00 RESET   / CSM POWER ON
      {0x01, 0xB5},  // 0x01 CLOCK_MANAGER / MCLK=BCLK (no separate MCLK line needed)
      {0x02, 0x18},  // 0x02 CLOCK_MANAGER / MULT_PRE=3
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      {0x37, 0x08},  // 0x37 DAC      / bypass the DAC equalizer
  };
  bool ok = true;
  for (auto& r : seq) ok = es8311Write(addr, r[0], r[1]) && ok;
#ifdef PODCAST_TARGET_STICKS3
  // StickS3's amp enable is NOT done here: the bitOn current surge, if it overlaps
  // connecttohost's TLS handshake, triggers brownout; instead it is enabled with a delay
  // by ampTick() after startPlayback succeeds (see ampEnableAt)
#endif
  Serial.printf("[audio] ES8311 init @0x%02X %s\n", addr, ok ? "ok" : "FAIL");
  return ok;
}

// Amp switch (only StickS3 has a separate PA enable bit; the Cardputer amp is driven along with the codec output)
static void setAmp(bool on) {
#ifdef PODCAST_TARGET_STICKS3
  if (on) M5.In_I2C.bitOn(M5PM1_ADDR, 0x11, 0b00001000, 100000);
  else    M5.In_I2C.bitOff(M5PM1_ADDR, 0x11, 0b00001000, 100000);
#else
  (void)on;
#endif
}

// Called every loop pass: enable the amp when due and fade the volume in step (non-blocking).
// After enabling, drop to a low volume first, then step up to the user volume every 150ms, avoiding pop and a second current surge
static void ampTick() {
  if (ampEnableAt != 0 && (int32_t)(millis() - ampEnableAt) >= 0) {
    ampEnableAt = 0;
    setAmp(true);
    ampFadeNow = 3;
    audio.setVolume(ampFadeNow);
    ampFadeAt = millis() + 150;
    Serial.println("[audio] amp on (delayed)");
  }
  if (ampFadeNow != 0 && (int32_t)(millis() - ampFadeAt) >= 0) {
    int target = player.volume;
    ampFadeNow += 3;
    if (ampFadeNow >= target) {
      audio.setVolume(target);
      ampFadeNow = 0;
    } else {
      audio.setVolume(ampFadeNow);
      ampFadeAt = millis() + 150;
    }
  }
}

// --------------------------- Playback control ---------------------------

static void startPlayback(int idx) {
  if (audio.isRunning()) audio.stopSong();
  paused = false;
  wifiDropPause = false;  // user started playback; clear the drop-wait flag
  player.current = idx;
  // Keep the amp off during connection: enable is delayed to 600ms after connect succeeds (ampTick),
  // staggered from the DNS+TLS+first-block download WiFi current spike, avoiding a brownout reboot
  setAmp(false);
  ampFadeNow = 0;

  // connecttohost blocks synchronously for seconds (DNS+TLS+GET+m4a header parse); draw the hint first
  statusMsg = "Buffering...";
  uiDirty = true;
  drawUI();
  uiDirty = false;

  if (!i2sConfigured) {
    // no MCLK pin (ES8311 already configured MCLK=BCLK)
#ifdef PODCAST_TARGET_STICKS3
    audio.setPinout(PIN_I2S_BCLK, PIN_I2S_WS, PIN_I2S_DOUT, PIN_I2S_MCLK);
#else
    audio.setPinout(PIN_I2S_BCLK, PIN_I2S_WS, PIN_I2S_DOUT);
#endif
    // Note: audioI2S 3.0.12 already calls InBuff.init() in the constructor (fixed 16000B),
    // setBufsize() is rejected by isInitialized(), so the buffer size can't be changed
    audio.setVolumeSteps(VOLUME_MAX);
    audio.setVolume(player.volume);
    audio.setConnectionTimeout(8000, 15000);
    i2sConfigured = true;
  }

  // Connect directly to the original https address. Do NOT change to plain http: this feed's audio goes
  // through the dts-api.xiaoyuzhoufm.com relay, which returns 302 for http requests with an all-uppercase
  // "HTTPS://..." Location; audioI2S 3.0.12 can't parse that redirect, showing
  // "connected" but no audio in the stream (duration stays --:--:--).
  // https requests redirect to a lowercase https://media.xyzcdn.net/... direct link, which works fine.
  uint32_t t0 = millis();
  Serial.printf("[audio] startPlayback idx=%d heap=%u\n", idx,
                (unsigned)ESP.getFreeHeap());
  bool ok = audio.connecttohost(episodes[idx].url.c_str());
  Serial.printf("[audio] connecttohost returned ok=%d after %ums\n",
                (int)ok, (unsigned)(millis() - t0));
  if (ok && !es8311Ready) {
    // I2S clock is already running; initializing ES8311 now matches M5Unified's timing
    es8311Ready = initEs8311();
    if (!es8311Ready) Serial.println("[audio] ES8311 init failed, no sound");
  }
  if (ok && es8311Ready) {
    // 600ms later loop->ampTick turns the amp on and fades in: the TLS burst is over by then,
    // and the input ring (12KB, ~1s of audio) covers this gap with no feed flow
    ampEnableAt = millis() + 600;
  }
  statusMsg = ok ? "" : "Connect failed";
  view = VIEW_PLAYER;   // enter the player page
  uiDirty = true;
}

// --------------------------- RSS fetch ---------------------------

// Parse a single <item>...</item> with TinyXML2, extracting the title and the enclosure direct link
static void parseEpisodeXml(const std::string& xml, std::vector<Episode>& out) {
  tinyxml2::XMLDocument doc;
  if (doc.Parse(xml.data(), xml.size()) != tinyxml2::XML_SUCCESS) return;
  const tinyxml2::XMLElement* item = doc.RootElement();
  if (item == nullptr) return;
  const tinyxml2::XMLElement* titleEl = item->FirstChildElement("title");
  const tinyxml2::XMLElement* encEl   = item->FirstChildElement("enclosure");
  if (titleEl == nullptr || encEl == nullptr) return;
  const char* t = titleEl->GetText();
  const char* u = encEl->Attribute("url");
  if (t == nullptr || u == nullptr) return;
  Episode ep;
  ep.title = cleanText(t);
  ep.url   = cleanText(u);
  if (!ep.title.empty() && !ep.url.empty()) out.push_back(ep);
}

// Streaming RSS fetch: the sliding window only buffers a single <item>; everything else is read and discarded.
// Returns whether at least one episode was parsed. isHttps=false uses a plaintext WiFiClient,
// bypassing mbedtls (the TLS stack uses a lot of memory, the biggest heap peak during fetch);
// in plaintext mode a redirect to https fails, handled by a fallback at the call site.
extern const uint8_t _binary_x509_crt_bundle_start[];  // IDF CA bundle (libmbedtls)
static bool fetchEpisodesFrom(const char* url, bool isHttps,
                              std::vector<Episode>& eps) {
  WiFiClientSecure secureClient;
  WiFiClient       plainClient;
  HTTPClient http;
  // Verify server certificates against the IDF Mozilla CA bundle (embedded in libmbedtls).
  // Without this, anyone on the path could substitute a fake feed.
  if (isHttps) secureClient.setCACertBundle(_binary_x509_crt_bundle_start);
  bool began = isHttps ? http.begin(secureClient, url)
                       : http.begin(plainClient, url);
  if (!began) return false;
  http.setFollowRedirects(HTTPC_STRICT_FOLLOW_REDIRECTS);
  http.setUserAgent("CardputerPodcast/1.0");
  http.setConnectTimeout(10000);
  int code = http.GET();
  if (code != HTTP_CODE_OK) {
    Serial.printf("[rss] HTTP GET code=%d\n", code);
    http.end();
    return false;
  }
  WiFiClient* stream = http.getStreamPtr();
  if (stream == nullptr) {
    http.end();
    return false;
  }
  stream->setTimeout(8000);

  std::string pending;   // small buffer when not inside an item (to match "<item" across chunks)
  std::string item;      // accumulation buffer for the current item
  bool inItem = false;
  size_t total = 0;
  uint8_t buf[1024];

  while (eps.size() < MAX_EPISODES && total < MAX_FEED_BYTES) {
    int n = (int)stream->readBytes(buf, sizeof(buf));
    if (n <= 0) break;  // stream ended
    total += (size_t)n;

    if (!inItem) {
      pending.append((const char*)buf, (size_t)n);
      size_t pos = pending.find("<item");
      if (pos != std::string::npos) {
        inItem = true;
        item = pending.substr(pos);
        pending.clear();
      } else if (pending.size() > 8) {
        // keep only the trailing 8 bytes, enough to match a cross-chunk "<item"
        pending.erase(0, pending.size() - 8);
      }
    } else {
      item.append((const char*)buf, (size_t)n);
      size_t pos = item.find("</item>");
      if (pos != std::string::npos) {
        // a complete item: hand it to TinyXML2
        parseEpisodeXml(item.substr(0, pos + 7), eps);
        // for the remaining content only backfill the trailing 8 bytes (enough to match a cross-chunk "<item");
        // don't copy the whole item tail (a wasted copy of up to several KB)
        size_t remStart = pos + 7;
        if (item.size() - remStart > 8) remStart = item.size() - 8;
        pending.assign(item, remStart, std::string::npos);
        item.clear();
        inItem = false;
      } else if (item.size() > MAX_ITEM_BYTES) {
        // abnormally long item: cannot clear the whole thing -- the buffer may already contain the start
        // of the next <item; discarding it directly would misalign parsing of later items (corrupt URL join).
        // Instead resync within the buffer to the next <item:
        size_t nxt = item.find("<item", 1);
        if (nxt != std::string::npos) {
          item.erase(0, nxt);  // continue collecting from the start of the next item
        } else {
          // no next one in the buffer: keep only the trailing 8 bytes for cross-chunk "<item" matching
          pending.assign(item, item.size() - 8, std::string::npos);
          item.clear();
          inItem = false;
        }
        Serial.println("[rss] item too large, resynced");
      }
    }
  }
  http.end();
  Serial.printf("[rss] %u episodes, %u bytes\n",
                (unsigned)eps.size(), (unsigned)total);
  return !eps.empty();
}

// Same strategy as playback: try a plaintext http direct link first (saves tens of KB of mbedtls heap peak),
// fall back to the original https address on failure.
static bool fetchEpisodesUrl(const std::string& feedUrl, std::vector<Episode>& eps) {
  String rss = String(feedUrl.c_str());
  if (rss.startsWith("http://")) {
    return fetchEpisodesFrom(rss.c_str(), false, eps);
  }
  String httpUrl = rss;
  httpUrl.replace("https://", "http://");
  Serial.printf("[rss] try http: %s\n", httpUrl.c_str());
  if (fetchEpisodesFrom(httpUrl.c_str(), false, eps)) return true;
  Serial.println("[rss] http failed, fallback to https");
  return fetchEpisodesFrom(rss.c_str(), true, eps);
}

static bool fetchEpisodes(std::vector<Episode>& eps) {
  return fetchEpisodesUrl(activeFeedUrl.empty() ? channels[chanIdx].rss : activeFeedUrl, eps);
}

// Fetch entry with on-screen hints (shared by first boot and the Enter retry when the list is empty)
static void fetchWithProgress() {
  statusMsg = "Fetch: " + (activeFeedName.empty() ? channels[chanIdx].name : activeFeedName);
  uiDirty = true;
  drawUI();
  uiDirty = false;

  episodes.clear();
  fetchEpisodes(episodes);
  cursor = 0;
  scrollTop = 0;
  statusMsg = episodes.empty() ? "Fetch failed, Enter: retry" : "";
  uiDirty = true;
}

// Switch channel: stop playback, clear the list, remember in NVS, refetch RSS (picking the same channel just returns to the list)
static void switchChannel(int idx) {
  if (idx < 0 || idx >= (int)channels.size()) return;
  activeFeedUrl.clear();   // leaving a discovered show
  activeFeedName.clear();
  if (idx != chanIdx) {
    if (audio.isRunning()) {
      audio.stopSong();
      while (audio.isRunning()) delay(10);  // wait until the decode thread fully stops before touching channel data
    }
    paused         = false;
    player.current = -1;
    chanIdx        = idx;
    Preferences p;
    p.begin("chan", false);
    p.putUChar("idx", (uint8_t)chanIdx);
    p.end();
    // cover is a text badge, switching channels is zero-cost
    statusMsg = "Switched: " + channels[chanIdx].name;
  }
  view    = VIEW_LIST;
  uiDirty = true;
  if (wifiOk) {
    fetchWithProgress();
  } else {
    episodes.clear();
    cursor    = 0;
    scrollTop = 0;
    statusMsg = "No Wi-Fi, press 0 to set up";
  }
}

// --------------------------- Drawing ---------------------------

// ----------------- Show discovery: Top Podcasts charts and search -----------------
// Uses Apple's public JSON endpoints (no API key). Results go to VIEW_SHOWS; opening
// a show loads its RSS into the normal episode list via activeFeedUrl.
static const char* const CATALOG_COUNTRY = "au";  // storefront for charts and search
static constexpr int CHARTS_LIMIT = 25;
static constexpr int SEARCH_LIMIT = 20;
static constexpr size_t SEARCH_MAX_CHARS = 40;

static std::vector<ShowEntry> shows;        // current charts or search results
static bool        showsAreSearch = false;
static int         showCursor = 0;
static int         showTop    = 0;
static std::string searchQuery;
static uint32_t    searchOpenedMs = 0;      // ignore typing for a moment after opening (the 'f' keypress itself)

// Percent-encode a search term for a URL query string.
static std::string urlEncodeQuery(const std::string& s) {
  std::string out;
  char buf[4];
  for (unsigned char c : s) {
    if (isalnum(c) || c == '-' || c == '_' || c == '.' || c == '~') {
      out += (char)c;
    } else if (c == ' ') {
      out += '+';
    } else {
      snprintf(buf, sizeof(buf), "%%%02X", (unsigned)c);
      out += buf;
    }
  }
  return out;
}

// GET a JSON endpoint and hand the body stream to `parse`. HTTPS is certificate-checked
// against the built-in CA bundle. Returns parse's result (false on any failure).
template <typename Parse>
static bool httpGetJson(const String& url, Parse parse) {
  WiFiClientSecure secure;
  secure.setCACertBundle(_binary_x509_crt_bundle_start);
  HTTPClient http;
  if (!http.begin(secure, url)) return false;
  http.setFollowRedirects(HTTPC_STRICT_FOLLOW_REDIRECTS);
  http.setUserAgent("CardputerPodcast/1.0");
  http.setConnectTimeout(10000);
  http.setTimeout(10000);
  int code = http.GET();
  bool ok = false;
  if (code == HTTP_CODE_OK) {
    WiFiClient* stream = http.getStreamPtr();
    if (stream != nullptr) {
      stream->setTimeout(8000);
      ok = parse(*stream);
    }
  } else {
    Serial.printf("[catalog] HTTP %d\n", code);
  }
  http.end();
  return ok;
}

// Look up the RSS feed URL for an Apple show id (charts only return names and ids).
static std::string lookupFeedUrl(uint64_t id) {
  char url[160];
  snprintf(url, sizeof(url),
           "https://itunes.apple.com/lookup?id=%llu&entity=podcast",
           (unsigned long long)id);
  std::string feed;
  httpGetJson(String(url), [&feed](Stream& s) {
    feed = parseLookupFeedUrl(s);
    return !feed.empty();
  });
  return feed;
}

// Fill `shows` from a charts or search URL. Returns true if anything was parsed.
static bool loadShowList(const String& url, bool search) {
  shows.clear();
  showCursor = 0;
  showTop    = 0;
  if (search) {
    return httpGetJson(url, [](Stream& s) {
      return parseSearchJson(s, shows, SEARCH_LIMIT) > 0;
    });
  }
  return httpGetJson(url, [](Stream& s) {
    return parseChartsJson(s, shows, CHARTS_LIMIT) > 0;
  });
}

// 'c' key: Top Podcasts for the storefront.
static void openCharts() {
  statusMsg = "Loading top podcasts...";
  uiDirty = true;
  drawUI();
  String url = String("https://rss.marketingtools.apple.com/api/v2/") +
               CATALOG_COUNTRY + "/podcasts/top/" + String(CHARTS_LIMIT) +
               "/podcasts.json";
  showsAreSearch = false;
  bool ok = loadShowList(url, false);
  view = VIEW_SHOWS;
  statusMsg = ok ? "" : "Charts failed (check WiFi)";
  uiDirty = true;
}

// Enter on the search page: run the query.
static void runSearch() {
  if (searchQuery.empty()) return;
  statusMsg = "Searching...";
  uiDirty = true;
  drawUI();
  String url = String("https://itunes.apple.com/search?media=podcast&entity=podcast&country=") +
               CATALOG_COUNTRY + "&limit=" + String(SEARCH_LIMIT) +
               "&term=" + urlEncodeQuery(searchQuery).c_str();
  showsAreSearch = true;
  bool ok = loadShowList(url, true);
  view = VIEW_SHOWS;
  statusMsg = ok ? "" : "No results (or search failed)";
  uiDirty = true;
}

// Enter on a show: resolve its feed, stop playback and load its episodes.
static void openShow(int idx) {
  if (idx < 0 || idx >= (int)shows.size()) return;
  ShowEntry show = shows[idx];  // copy: the list may be rebuilt below
  statusMsg = "Loading: " + show.name;
  uiDirty = true;
  drawUI();
  std::string feed = show.feedUrl.empty() ? lookupFeedUrl(show.id) : show.feedUrl;
  if (feed.empty()) {
    statusMsg = "No feed for this show";
    uiDirty = true;
    return;
  }
  if (audio.isRunning()) {
    audio.stopSong();
    while (audio.isRunning()) delay(10);
  }
  paused         = false;
  player.current = -1;
  activeFeedUrl  = feed;
  activeFeedName = show.name;
  episodes.clear();
  fetchEpisodesUrl(feed, episodes);
  cursor    = 0;
  scrollTop = 0;
  view      = VIEW_LIST;
  statusMsg = episodes.empty() ? "Fetch failed, Enter: retry" : "";
  uiDirty   = true;
}

// Keyboard input for the search page (Cardputer only). Adds typed characters,
// handles Backspace. Ignores keys held down when the page opened.
#ifndef PODCAST_TARGET_STICKS3
static void handleSearchTyping() {
  if (millis() - searchOpenedMs < 300) return;
  auto& kb = M5Cardputer.Keyboard;
  auto st = kb.keysState();
  static bool hadKeys = false;
  bool hasKeys = !st.word.empty() || st.del;
  if (hasKeys && !hadKeys) {  // new key press only (edge)
    for (char c : st.word) {
      if (searchQuery.size() < SEARCH_MAX_CHARS && c >= 32 && c < 127) searchQuery += c;
    }
    if (st.del && !searchQuery.empty()) searchQuery.pop_back();
    uiDirty = true;
  }
  hadKeys = hasKeys;
}
#endif  // !PODCAST_TARGET_STICKS3

static void drawShowsPage() {
  auto& d = M5.Display;
  d.fillScreen(C_BG);
  d.setTextColor(C_ACCENT, C_BG);
  d.drawString(showsAreSearch ? "Search results" : "Top podcasts (AU)", 2, 1);

  int visible = listLines - 2;
  if (showCursor < showTop) showTop = showCursor;
  if (showCursor >= showTop + visible) showTop = showCursor - visible + 1;
  int maxTop = (int)shows.size() > visible ? (int)shows.size() - visible : 0;
  if (showTop > maxTop) showTop = maxTop;

  if (shows.empty()) {
    d.setTextColor(C_DIM, C_BG);
    d.drawString("No results", 2, listTop + 4);
  }
  for (int row = 0; row < visible; ++row) {
    int idx = showTop + row;
    if (idx >= (int)shows.size()) break;
    int  y   = listTop + row * lineHeight;
    bool sel = (idx == showCursor);
    if (sel) d.fillRect(0, y, d.width(), lineHeight, C_SELECT);
    std::string prefix = showsAreSearch ? "" : std::to_string(idx + 1) + ". ";
    std::string line = std::string(sel ? "> " : "  ") + prefix + shows[idx].name;
    d.setTextColor(sel ? C_TEXT : C_DIM, sel ? C_SELECT : C_BG);
    d.drawString(fitText(line, d.width() - 6).c_str(), 2, y + 1);
  }
  d.setTextColor(C_DIM, C_BG);
  d.drawString("w/s:sel Enter:open Tab:back", 2, d.height() - 17);
}

static void drawSearchPage() {
  auto& d = M5.Display;
  d.fillScreen(C_BG);
  d.setTextColor(C_ACCENT, C_BG);
  d.drawString("Search podcasts", 2, 1);
  d.setTextColor(C_TEXT, C_BG);
  std::string line = "> " + searchQuery + "_";
  d.drawString(fitText(line, d.width() - 6).c_str(), 2, listTop + 4);
  d.setTextColor(C_DIM, C_BG);
  d.drawString("type, Enter:search Tab:back", 2, d.height() - 17);
}

// 'o' key: flip episode order (feeds are normally newest-first). Keeps the selected
// and playing episodes selected after the reversal.
static bool episodesOldestFirst = false;
static void syncScroll();
static void toggleEpisodeOrder() {
  if (episodes.size() < 2) return;
  std::string selUrl = (player.current >= 0 && player.current < (int)episodes.size())
                           ? episodes[player.current].url
                           : (cursor < (int)episodes.size() ? episodes[cursor].url : std::string());
  std::reverse(episodes.begin(), episodes.end());
  episodesOldestFirst = !episodesOldestFirst;
  for (int i = 0; i < (int)episodes.size(); ++i) {
    if (episodes[i].url == selUrl) {
      if (player.current >= 0) player.current = i;
      cursor = i;
      break;
    }
  }
  syncScroll();
  statusMsg = episodesOldestFirst ? "Oldest first" : "Newest first";
  uiDirty = true;
}

static void syncScroll() {
  if (cursor < scrollTop) scrollTop = cursor;
  if (cursor >= scrollTop + listLines) scrollTop = cursor - listLines + 1;
}

// Status bar: WiFi | status hint (auto width-limited) | volume
static void drawStatusBar() {
  auto& d = M5.Display;
  d.fillRect(0, 0, d.width(), listTop - 2, C_BG);

  d.setTextColor(wifiOk ? C_ACCENT : C_DIM, C_BG);
  d.drawString(wifiOk ? "WiFi:OK" : "WiFi:NG", 2, 1);

  // status text: usable width 58..188
  const char* st = nullptr;
  uint16_t stColor = C_TEXT;
  if (!statusMsg.empty()) {
    st = statusMsg.c_str();
    stColor = C_WARN;
  } else if (audio.isRunning() && !paused) {
    st = "Playing";
    stColor = C_ACCENT;
  } else if (player.current >= 0) {
    st = "Paused";
  } else {
    st = "Stopped";
  }
  std::string shown = fitText(st, 128);
  int w = d.textWidth(shown.c_str());
  d.setTextColor(stColor, C_BG);
  d.drawString(shown.c_str(), 58 + (128 - w) / 2, 1);

  char vol[16];
  snprintf(vol, sizeof(vol), "Vol:%d", player.volume);
  d.setTextColor(C_DIM, C_BG);
  d.drawString(vol, d.width() - d.textWidth(vol) - 2, 1);
}

// List page
static void drawListPage() {
  auto& d = M5.Display;
  // Clear the whole list area first (everything below the status bar), otherwise after a cursor move/scroll old-frame text
  // and the old selection bar remain in the row gaps, looking like "the layer below shows through"
  d.fillRect(0, listTop - 2, d.width(), d.height() - listTop + 2, C_BG);
  if (episodes.empty()) {
    d.setTextColor(C_DIM, C_BG);
    d.drawString("Episode list empty", 2, listTop);
    d.drawString(HINT_RETRY, 2, listTop + lineHeight);
  } else {
    for (int row = 0; row < listLines; ++row) {
      int idx = scrollTop + row;
      if (idx >= (int)episodes.size()) break;
      int y = listTop + row * lineHeight;
      bool selected  = (idx == cursor);
      bool isPlaying = (idx == player.current);
      if (selected) {
        d.fillRect(0, y, d.width(), lineHeight, C_SELECT);
      }
      char prefix[10];
      snprintf(prefix, sizeof(prefix), "%2d%s", idx + 1, isPlaying ? ">" : " ");
      std::string line = std::string(prefix) + " " + episodes[idx].title;
      std::string shown = fitText(line, d.width() - 6);
      if (selected) {
        d.setTextColor(C_TEXT, C_SELECT);
      } else if (isPlaying) {
        d.setTextColor(C_ACCENT, C_BG);
      } else {
        d.setTextColor(C_DIM, C_BG);
      }
      d.drawString(shown.c_str(), 2, y + 1);
    }
  }
}

// Progress bar + time (used for the partial refresh)
static void drawProgressArea() {
  auto& d = M5.Display;
  constexpr int PX = 116, PW = 120;
  d.fillRect(PX, 80, PW, 26, C_BG);

  uint32_t dur = audio.getAudioFileDuration();
  uint32_t cur = audio.getAudioCurrentTime();
  // dur unknown (0) keeps cur: elapsed time still advances, just the total shows --:--
  if (dur > 0 && cur > dur) cur = dur;

  // progress bar
  d.fillRect(PX, 82, PW, 6, C_BAR_BG);
  if (dur > 0) {
    int fill = (int)((uint64_t)PW * cur / dur);
    if (fill > 0) d.fillRect(PX, 82, fill, 6, C_ACCENT);
  }
  // while playing give the bar tail a highlight dot; none when paused
  if (audio.isRunning() && !paused && dur > 0) {
    int fill = (int)((uint64_t)PW * cur / dur);
    d.fillRect(PX + fill - 2, 81, 3, 8, C_TEXT);
  }

  // time
  char tbuf[48];
  snprintf(tbuf, sizeof(tbuf), "%s / %s",
           fmtTime(cur).c_str(), fmtTime(dur).c_str());
  d.setTextColor(C_DIM, C_BG);
  d.drawString(tbuf, PX, 92);
}

// Player page: cover + channel name + title + progress (full=false refreshes only the progress area)
static void drawPlayerPage(bool full) {
  auto& d = M5.Display;
  if (full) {
    d.fillScreen(C_BG);

    // Text cover badge (colored by channel name hash: gradient background + corners + large text)
    drawCoverArt(6, 26, 100, 100, channels[chanIdx].name);

    // channel name (white) + accent line
    d.setTextColor(C_ACCENT, C_BG);
    d.drawString(channels[chanIdx].name.c_str(), 116, 26);
    d.fillRect(116, 43, 40, 2, C_ACCENT);

    // title: at most two lines
    if (player.current >= 0 && player.current < (int)episodes.size()) {
      auto lines = wrapText(episodes[player.current].title, 120, 2);
      d.setTextColor(C_TEXT, C_BG);
      for (size_t i = 0; i < lines.size(); ++i) {
        d.drawString(lines[i].c_str(), 116, 48 + (int)i * 17);
      }
    }
    // bottom operation hint
    d.setTextColor(C_DIM, C_BG);
    d.drawString(HINT_BACK, 116, 116);
  }
  drawProgressArea();
}

// Channel switch page: cursor selects a channel, * marks the current channel, Enter confirms the switch
static void drawChannelPage() {
  auto& d = M5.Display;
  d.fillScreen(C_BG);
  d.setTextColor(C_ACCENT, C_BG);
  d.drawString("Select channel", 2, 1);

  int visible = listLines - 2;  // title and bottom hint each take a row
  if (chanCursor < chanTop) chanTop = chanCursor;
  if (chanCursor >= chanTop + visible) chanTop = chanCursor - visible + 1;
  int maxTop = (int)channels.size() > visible
                   ? (int)channels.size() - visible
                   : 0;
  if (chanTop > maxTop) chanTop = maxTop;

  for (int row = 0; row < visible; ++row) {
    int  idx   = chanTop + row;
    if (idx >= (int)channels.size()) break;
    int  y     = listTop + row * lineHeight;
    bool sel   = (idx == chanCursor);
    bool isCur = (idx == chanIdx);
    if (sel) d.fillRect(0, y, d.width(), lineHeight, C_SELECT);
    // channel-specific color block (same color as the text cover, to recognize channels by color)
    d.fillRect(2, y + 4, 10, 10, coverTopColor(channels[idx].name));
    std::string line = std::string(sel ? "> " : "   ") + channels[idx].name +
                       (isCur ? " *" : "");
    d.setTextColor(sel ? C_TEXT : (isCur ? C_ACCENT : C_DIM),
                   sel ? C_SELECT : C_BG);
    d.drawString(fitText(line, d.width() - 6).c_str(), 2, y + 1);
  }
  d.setTextColor(C_DIM, C_BG);
  d.drawString("w/s:sel Enter:ok Tab:back", 2, d.height() - 17);
}

static void drawUI() {
  drawStatusBar();
  if (view == VIEW_LIST) {
    drawListPage();
  } else if (view == VIEW_CHANNEL) {
    drawChannelPage();
  } else if (view == VIEW_SHOWS) {
    drawShowsPage();
  } else if (view == VIEW_SEARCH) {
    drawSearchPage();
  } else {
    drawPlayerPage(true);
  }
}

// --------------------------- Keys ---------------------------

// Exit to M5Launcher: an app launched by the Launcher stays in this app after reboot (otadata),
// so the boot partition must be explicitly switched back to the Launcher before rebooting
static void returnToLauncher() {
  const esp_partition_t* part = esp_ota_get_next_update_partition(nullptr);
  if (part != nullptr) {
    esp_ota_set_boot_partition(part);
  }
  esp_restart();
}

static void handleKeys() {
#ifdef PODCAST_TARGET_STICKS3
  // ---- StickS3 two-button input layer: translates BtnA/BtnB events into the same input primitives as the keyboard ----
  // list page: A click=down  A long-hold repeat=up  B click=play selected  B hold 1.5s=WiFi setup
  // player page: A click=back to list  A long-hold repeat=volume+  B click=play/pause  B long-hold repeat=volume-
  bool up = false, down = false, volUp = false, volDn = false;
  bool back = false, cfg = false;
  bool enter = M5.BtnB.wasClicked();  // B click = Enter (edge-triggered)
  {
    static uint32_t aPressMs = 0, bPressMs = 0, aLast = 0, bLast = 0;
    static bool     bCfgDone = false;
    static uint32_t downUntil = 0, upUntil = 0, cfgUntil = 0;
    const uint32_t  now = millis();
    const bool      aOn = M5.BtnA.isPressed();
    const bool      bOn = M5.BtnB.isPressed();
    if (aOn && aPressMs == 0) { aPressMs = now; aLast = 0; }
    if (bOn && bPressMs == 0) { bPressMs = now; bLast = 0; bCfgDone = false; }
    if (!aOn) aPressMs = 0;
    if (!bOn) bPressMs = 0;
    const bool inPlayer = (view == VIEW_PLAYER);
    if (M5.BtnA.wasClicked()) {              // A click
      if (inPlayer) upUntil = now + 120;     //   player page -> back to list
      else          downUntil = now + 120;   //   list page -> move down
    }
    if (aOn && now - aPressMs >= 500) {      // A long press (M5Unified hold threshold is also 500ms)
      if (inPlayer) {                        //   player page: volume+ repeat
        if (now - aLast >= 250) { volUp = true; aLast = now; }
      } else if (now - aLast >= 350) {       //   list page: move up repeat
        upUntil = now + 120; aLast = now;
      }
    }
    if (bOn && now - bPressMs >= 500 && inPlayer) {  // B long press: volume- repeat
      if (now - bLast >= 250) { volDn = true; bLast = now; }
    }
    if (bOn && now - bPressMs >= 1500 && !inPlayer && !bCfgDone) {
      cfgUntil = now + 120;  // list page B hold 1.5s: open WiFi setup
      bCfgDone = true;       // don't re-trigger after returning from setup until released
    }
    down = now < downUntil;
    up   = now < upUntil;
    cfg  = now < cfgUntil;
  }
#else
  auto& kb = M5Cardputer.Keyboard;
  bool up    = kb.isKeyPressed(';') || kb.isKeyPressed('w');
  bool down  = kb.isKeyPressed('.') || kb.isKeyPressed('s');
  bool volUp = kb.isKeyPressed('=') || kb.isKeyPressed('+');
  bool volDn = kb.isKeyPressed('-') || kb.isKeyPressed('_');
  bool back  = kb.isKeyPressed('`');
  bool enter = kb.keysState().enter;
  bool cfg   = false;  // '0' key is read in the setup block below
#endif
#ifndef PODCAST_TARGET_STICKS3
  if (view == VIEW_SEARCH) {       // while typing, letters must not move the cursor or change volume
    up = down = volUp = volDn = false;
    handleSearchTyping();
  }
#endif

  if (back) {
    returnToLauncher();  // does not return
  }

  // ---- up/down: move cursor on the list page; return to the list on the player page ----
  static bool     lastUp = false, lastDown = false;
  static uint32_t lastNavMs = 0;
  uint32_t now = millis();
  if (up != lastUp || down != lastDown) lastNavMs = 0;
  lastUp = up;
  lastDown = down;
  if (up || down) {
    if (view == VIEW_PLAYER) {
      if (now - lastNavMs >= 200) {
        view = VIEW_LIST;   // player page up/down key -> back to list
        lastNavMs = now;
        uiDirty = true;
      }
    } else if (view == VIEW_CHANNEL && now - lastNavMs >= 160) {
      // channel page: cursor moves over the channel list
      if (up && chanCursor > 0) {
        --chanCursor;
        lastNavMs = now;
        uiDirty = true;
      }
      if (down && chanCursor < (int)channels.size() - 1) {
        ++chanCursor;
        lastNavMs = now;
        uiDirty = true;
      }
    } else if (view == VIEW_SHOWS && now - lastNavMs >= 160) {
      if (up && showCursor > 0) {
        --showCursor;
        lastNavMs = now;
        uiDirty = true;
      }
      if (down && showCursor < (int)shows.size() - 1) {
        ++showCursor;
        lastNavMs = now;
        uiDirty = true;
      }
    } else if (view == VIEW_SEARCH) {
      // no list navigation on the search page
    } else if (now - lastNavMs >= 160) {
      if (up && cursor > 0) {
        --cursor;
        syncScroll();
        lastNavMs = now;
        uiDirty = true;
      }
      if (down && now - lastNavMs >= 160 &&
          cursor < (int)episodes.size() - 1) {
        ++cursor;
        syncScroll();
        lastNavMs = now;
        uiDirty = true;
      }
    }
  }

  // ---- volume (takes effect live during playback) ----
  static uint32_t lastVolMs = 0;
  if (volUp && now - lastVolMs >= 150 && player.volume < VOLUME_MAX) {
    ++player.volume;
    lastVolMs = now;
    audio.setVolume(player.volume);
    uiDirty = true;
  }
  if (volDn && now - lastVolMs >= 150 && player.volume > 0) {
    --player.volume;
    lastVolMs = now;
    audio.setVolume(player.volume);
    uiDirty = true;
  }

  // ---- 0 (keyboard) / B hold 1.5s (StickS3): open the WiFi setup hotspot on the list page ----
  static bool lastCfg = false;
#ifndef PODCAST_TARGET_STICKS3
  cfg = kb.isKeyPressed('0');  // keyboard-less targets set this in the A/B gesture layer above
#endif
  if (cfg && !lastCfg && view == VIEW_LIST) {
    bool connected = openPortal();
    // setup succeeded and there's no episode list yet -> fetch while at it
    if (connected && episodes.empty()) fetchWithProgress();
  }
  lastCfg = cfg;

#ifndef PODCAST_TARGET_STICKS3
  // ---- c: Top Podcasts charts, f: search (list page only; edge-triggered) ----
  static bool lastC = false, lastF = false;
  bool keyC = kb.isKeyPressed('c');
  bool keyF = kb.isKeyPressed('f');
  if (keyC && !lastC && view == VIEW_LIST) openCharts();
  static bool lastO = false;
  bool keyO = kb.isKeyPressed('o');
  if (keyO && !lastO && view == VIEW_LIST) toggleEpisodeOrder();
  lastO = keyO;
  if (keyF && !lastF && view == VIEW_LIST) {
    searchQuery.clear();
    searchOpenedMs = millis();
    view = VIEW_SEARCH;
    uiDirty = true;
  }
  lastC = keyC;
  lastF = keyF;

  // ---- Tab: channel switcher page toggle (the Esc key isn't reported by the M5Cardputer keyboard library, so Tab is used instead) ----
  static bool lastTab = false;
  bool tab = kb.isKeyPressed('\t');
  if (tab && !lastTab) {
    if (view == VIEW_CHANNEL || view == VIEW_SHOWS || view == VIEW_SEARCH) {
      view = VIEW_LIST;        // press Tab again to return to the list
    } else if (view == VIEW_LIST) {
      chanCursor = chanIdx;    // position the cursor on the current channel when opening
      view       = VIEW_CHANNEL;
    }
    uiDirty = true;
  }
  lastTab = tab;
#endif  // !PODCAST_TARGET_STICKS3

  // ---- Enter (edge-triggered; long press does not repeat) ----
  // channel page: Enter confirms the switch; list page: Enter selects the current episode = opens its player page
  // (starts playback if not playing); player page: Enter = pause / resume / replay
  static bool lastEnter = false;
  if (enter && !lastEnter) {
    if (view == VIEW_CHANNEL) {
      switchChannel(chanCursor);
    } else if (view == VIEW_SEARCH) {
      runSearch();
    } else if (view == VIEW_SHOWS) {
      openShow(showCursor);
    } else if (episodes.empty()) {
      fetchWithProgress();                    // list empty: retry
    } else if (view == VIEW_PLAYER) {
      if (audio.isRunning() && !paused) {
        // currently playing -> pause
        audio.pauseResume();
        paused = true;
      } else if (paused) {
        // paused -> resume; if paused too long and the CDN disconnects, loop turns it into an EOF hint
        audio.pauseResume();
        paused = false;
        audio.loop();                         // feed once immediately to probe whether the connection is alive
        if (!audio.isRunning()) statusMsg = "Link dropped, Enter: replay";
      } else {
        startPlayback(player.current >= 0 ? player.current : cursor);
      }                                      // finished/connect failed -> replay
      uiDirty = true;
    } else if (player.current == cursor) {
      // list page selecting the playing/paused episode -> just enter the player page, don't change playback state
      view = VIEW_PLAYER;
      uiDirty = true;
    } else {
      startPlayback(cursor);                  // play the newly selected episode
    }
  }
  lastEnter = enter;
}

// --------------------------- Main flow ---------------------------

void setup() {
#ifdef PODCAST_TARGET_STICKS3
  // CPU 240 -> 160MHz: ample headroom for AAC decoding, notably less heat and power
  // (the whole unit gets too hot during continuous playback). Before M5.begin, applies throughout
  setCpuFrequencyMhz(160);
#endif
  auto cfg = M5.config();
  // The onboard speaker/mic are fully driven by ESP32-audioI2S itself;
  // M5Unified only handles the display, board detection and internal I2C bus
  cfg.internal_spk = false;
  cfg.internal_mic = false;
#ifdef PODCAST_TARGET_STICKS3
  M5.begin(cfg);  // StickS3 is auto-detected by M5Unified at runtime
#else
  M5Cardputer.begin(cfg);
#endif

  Serial.begin(115200);
  auto& d = M5.Display;
#ifdef PODCAST_TARGET_STICKS3
  d.setRotation(1);  // native 135x240 portrait -> rotate to 240x135 landscape (same layout as Cardputer)
#endif
  Serial.printf("[app] display %dx%d resetReason=%d\n", (int)d.width(),
                (int)d.height(), (int)esp_reset_reason());

  // List layout computed from the actual screen height (CardputerADV canvas 240x135)
  listTop = 20;
  lineHeight = 19;
  listLines = (d.height() - listTop) / lineHeight;
  if (listLines < 1) listLines = 1;

  d.setTextDatum(m5gfx::textdatum_t::top_left);
  d.setFont(&fonts::efontCN_16);
  d.fillScreen(C_BG);
  d.setTextColor(C_TEXT, C_BG);

  // ---- Channel loading ----
  d.drawString("Loading channels...", 2, 1);
#ifdef PODCAST_TARGET_STICKS3
  // StickS3 version: single channel. Prefer a custom channel saved on the config page (NVS, change
  // without reflashing), else the firmware built-in channel. Editing RSS on the config page: see applyPortalChannel
  {
    ChannelEntry ce;
    Preferences p;
    p.begin("stickchan", true);
    String nvsRss   = p.getString("rss", "");
    String nvsName  = p.getString("name", "");
    p.end();
    if (nvsRss.length() > 0) {
      ce.name = nvsName.length() ? nvsName.c_str() : STICKS3_CHANNEL_NAME;
      ce.rss  = nvsRss.c_str();
      Serial.printf("[chan] custom channel from NVS: %s\n", ce.rss.c_str());
    } else {
      ce.name = STICKS3_CHANNEL_NAME;
      ce.rss  = STICKS3_CHANNEL_RSS;
      Serial.println("[chan] built-in single channel");
    }
    channels.push_back(ce);
  }
#else
  // SD /channels.txt > NVS cache > compiled-in
  {
    sdSPI.begin(PIN_SD_SCK, PIN_SD_MISO, PIN_SD_MOSI, PIN_SD_CS);
    sdReady = SD.begin(PIN_SD_CS, sdSPI, 25000000);
    Serial.printf("[sd] %s\n", sdReady ? "mounted" : "not found");
  }

  bool fromSD = false;
  if (sdReady) {
    File f = SD.open("/channels.txt");
    if (f) {
      std::string txt;
      txt.reserve(f.size());
      while (f.available()) txt.push_back((char)f.read());
      f.close();
      if (txt.size() >= 3 && (uint8_t)txt[0] == 0xEF &&
          (uint8_t)txt[1] == 0xBB && (uint8_t)txt[2] == 0xBF) {
        txt.erase(0, 3);  // strip UTF-8 BOM
      }
      size_t pos = 0;
      while (pos < txt.size() && channels.size() < 16) {
        size_t eol = txt.find('\n', pos);
        std::string line = txt.substr(
            pos, eol == std::string::npos ? std::string::npos : eol - pos);
        pos = (eol == std::string::npos) ? txt.size() : eol + 1;
        if (!line.empty() && line.back() == '\r') line.pop_back();
        size_t b = line.find_first_not_of(" \t");
        if (b == std::string::npos) continue;
        size_t e = line.find_last_not_of(" \t");
        line = line.substr(b, e - b + 1);
        if (line[0] == '#') continue;  // comment line
        // split by | and trim leading/trailing whitespace
        std::vector<std::string> parts;
        size_t p2 = 0;
        while (true) {
          size_t bar = line.find('|', p2);
          std::string seg = line.substr(
              p2, bar == std::string::npos ? std::string::npos : bar - p2);
          size_t sb = seg.find_first_not_of(" \t");
          parts.push_back(sb == std::string::npos
                              ? ""
                              : seg.substr(sb,
                                           seg.find_last_not_of(" \t") - sb + 1));
          if (bar == std::string::npos) break;
          p2 = bar + 1;
        }
        if (parts.size() < 2 || parts[0].empty() ||
            parts[1].compare(0, 4, "http") != 0) {
          Serial.printf("[chan] skip bad line: %s\n", line.c_str());
          continue;
        }
        ChannelEntry ce;
        ce.name     = parts[0];
        ce.rss      = parts[1];
        channels.push_back(ce);
      }
      fromSD = !channels.empty();
      Serial.printf("[chan] SD: %d channels\n", (int)channels.size());
    } else {
      Serial.println("[chan] SD: no /channels.txt");
    }
  }

  if (fromSD) {
    // SD config parsed successfully -> cache into NVS, fallback when the card is removed/bad
    // (blob2 = v2 layout: [u8 name len][name][u8 rss len][rss], no cover field)
    std::string blob;
    for (auto& c : channels) {
      blob.push_back((char)c.name.size());
      blob.append(c.name);
      blob.push_back((char)c.rss.size());
      blob.append(c.rss);
    }
    Preferences p;
    p.begin("chanlist", false);
    p.putBytes("blob2", blob.data(), blob.size());
    p.end();
  } else {
    // SD not configured -> read the last cached channel list
    Preferences p;
    p.begin("chanlist", true);
    size_t n = p.getBytesLength("blob2");
    if (n > 0) {
      std::vector<char> buf(n);
      p.getBytes("blob2", buf.data(), n);
      p.end();
      size_t cpos = 0;
      while (cpos + 2 <= buf.size() && channels.size() < 16) {
        size_t nl = (uint8_t)buf[cpos++];
        if (cpos + nl > buf.size()) break;
        ChannelEntry ce;
        ce.name.assign(buf.data() + cpos, nl);
        cpos += nl;
        if (cpos >= buf.size()) break;
        size_t rl = (uint8_t)buf[cpos++];
        if (cpos + rl > buf.size()) break;
        ce.rss.assign(buf.data() + cpos, rl);
        cpos += rl;
        channels.push_back(ce);
      }
      if (!channels.empty()) {
        Serial.printf("[chan] NVS cache: %d channels\n", (int)channels.size());
      }
    } else {
      p.end();
    }
  }
#endif  // !PODCAST_TARGET_STICKS3

  if (channels.empty()) {
    // final fallback: compiled-in channel table (works even if channels.txt is missing)
    for (int i = 0; i < CHANNEL_COUNT; ++i) {
      ChannelEntry ce;
      ce.name = CHANNELS[i].name;
      ce.rss  = CHANNELS[i].rss;
      channels.push_back(ce);
    }
    Serial.println("[chan] using embedded channels");
  }

  // last selected channel (NVS, out-of-range falls back to index 0)
  {
    Preferences p;
    p.begin("chan", true);
    chanIdx = p.getUChar("idx", 0);
    p.end();
    if (chanIdx < 0 || chanIdx >= (int)channels.size()) chanIdx = 0;
  }
  Serial.printf("[app] channel %d: %s\n", chanIdx,
                channels[chanIdx].name.c_str());

  // Crash forensics: show the reason for the previous reset on the boot screen (to diagnose crashes without a PC)
  // esp_reset_reason: 1=normal power-on 2=software restart 3=panic 4=interrupt watchdog 5=task watchdog
  //                   6=hardware watchdog 7=deep-sleep wake 8=brownout (voltage drop)
  {
    esp_reset_reason_t r = esp_reset_reason();
    const char* why;
    switch (r) {
      case ESP_RST_POWERON:   why = "power-on";     break;
      case ESP_RST_SW:        why = "soft reset";   break;
      case ESP_RST_PANIC:     why = "panic!";       break;
      case ESP_RST_INT_WDT:   why = "int WDT!";     break;
      case ESP_RST_TASK_WDT:  why = "task WDT!";    break;
      case ESP_RST_WDT:       why = "hw WDT!";      break;
      case ESP_RST_DEEPSLEEP: why = "deep sleep";   break;
      case ESP_RST_BROWNOUT:  why = "brownout!";    break;
      default:                why = "unknown";     break;
    }
    Serial.printf("[app] resetReason=%d heapNow=%u heapMin=%u\n", (int)r,
                  (unsigned)ESP.getFreeHeap(), (unsigned)ESP.getMinFreeHeap());
    if (r != ESP_RST_POWERON && r != ESP_RST_DEEPSLEEP) {
      d.fillRect(0, 18, d.width(), 16, C_BG);
      d.setTextColor(C_TEXT, C_BG);
      d.drawString(String("Last abort: ") + why, 2, 18);
      delay(4000);  // stay 4 seconds on abnormal reset so the reason is clearly visible
    }
  }

  d.fillScreen(C_BG);
  d.setTextColor(C_TEXT, C_BG);
  d.drawString("Connecting Wi-Fi...", 2, 1);

  // 1) WiFi: WiFiManager fully managed -- tries NVS stored credentials first, auto-starts the hotspot on failure
  //    "PodcastPlayer" + captive portal (phone joins and the config page auto-pops)
  WiFiManager wm;
  makePortalPassword();
  wm.setConnectTimeout(10);          // wait for a connect attempt with stored credentials
  wm.setConfigPortalTimeout(180);    // auto-close the hotspot after 3 min of inactivity
  wm.setAPCallback([](WiFiManager*) { drawPortalScreen(); });
#ifdef PODCAST_TARGET_STICKS3
  // Config page includes channel settings (users can fill in their own RSS on first boot)
  WiFiManagerParameter prmName("chan", "Channel name", channels[0].name.c_str(), 48);
  WiFiManagerParameter prmRss("rss", "Podcast RSS URL",
                              channels[0].rss.c_str(), 256);
  wm.addParameter(&prmName);
  wm.addParameter(&prmRss);
#endif
  wifiOk = wm.autoConnect(AP_NAME, portalPass);
  if (wifiOk) {
    WiFi.setSleep(false);           // online streaming needs stable throughput
    WiFi.setAutoReconnect(true);    // auto-reconnect at the low level after a router blip
  }
#ifdef PODCAST_TARGET_STICKS3
  // If RSS was changed during first configuration: channels[0] is already updated, the first fetch below uses the new source
  applyPortalChannel(prmName.getValue(), prmRss.getValue());
  refetchNeeded = false;  // the tail of setup fetches anyway, no extra trigger needed
#endif
  Serial.printf("[app] wifi %s\n", wifiOk ? "connected" : "FAILED");

  // 2) RSS episode list (ES8311 is initialized lazily on first playback, needs the I2S clock running first)
  d.fillScreen(C_BG);
  if (wifiOk) {
    fetchWithProgress();
  } else {
    d.setTextColor(C_WARN, C_BG);
    d.drawString("Wi-Fi not connected", 2, 1);
    d.drawString("Press 0 for WiFi setup", 2, 21);
    d.setTextColor(C_TEXT, C_BG);
  }

  uiDirty = true;
}

void loop() {
#ifdef PODCAST_TARGET_STICKS3
  M5.update();  // refresh BtnA/BtnB state (for wasClicked/isPressed)
#else
  M5Cardputer.update();
#endif
  handleKeys();
#ifdef PODCAST_TARGET_STICKS3
  // RSS changed on the config page: refetch the new channel's episodes after returning to the list
  if (refetchNeeded && !audio.isRunning()) {
    refetchNeeded = false;
    view = VIEW_LIST;
    fetchWithProgress();
  }
#endif
  ampTick();  // delayed amp enable + volume fade-in (brownout avoidance)

  // Feed the decoder (returns immediately when paused). EOF detection:
  // was running last pass, gone this pass, and not a user pause -> finished
  audio.loop();
  static bool wasRunning = false;
  bool running = audio.isRunning();
  if (wasRunning && !running && !paused && statusMsg.empty()) {
    statusMsg = "Finished";
    uiDirty = true;
  }
  wasRunning = running;

  // Player page progress bar partial refresh once per second (a static page isn't fully redrawn)
  static uint32_t lastProgressMs = 0;
  if (view == VIEW_PLAYER && audio.isRunning() && !paused &&
      millis() - lastProgressMs >= 1000) {
    lastProgressMs = millis();
    drawPlayerPage(false);
  }

  // While playing, check WiFi every pass: a drop cleanly stops the stream immediately.
  // Continuing to decode on a dead socket is the root cause of crackle for a few minutes then crash-reboot
  if (audio.isRunning() && WiFi.status() != WL_CONNECTED) {
    int sec = audio.getAudioCurrentTime();
    audio.stopSong();
    paused = false;
    wifiDropPause = true;
    char buf[64];
    snprintf(buf, sizeof(buf), "WiFi lost %02d:%02d, Enter: replay",
             sec / 60, sec % 60);
    statusMsg = buf;
    Serial.printf("[net] dropped while playing at %ds\n", sec);
    uiDirty = true;
  }

  // WiFi auto-reconnect + heap monitoring (low frequency)
  static uint32_t lastWifiCheck = 0;
  if (millis() - lastWifiCheck > 3000) {
    lastWifiCheck = millis();
    bool ok = (WiFi.status() == WL_CONNECTED);
    if (!ok) WiFi.reconnect();
    if (ok != wifiOk) {
      wifiOk = ok;
      if (ok && wifiDropPause && !audio.isRunning()) {
        wifiDropPause = false;
        statusMsg = "Wi-Fi restored, Enter: replay";
      }
      uiDirty = true;
    }
    Serial.printf("[net] wifi=%d heap=%u minHeap=%u\n", ok,
                  (unsigned)ESP.getFreeHeap(), (unsigned)ESP.getMinFreeHeap());
  }

  if (uiDirty) {
    drawUI();
    uiDirty = false;
  }
}
